# BAT32A239 register map
Vendor: CMS; Series: BAT32A239; File version: 1.0
CPU: CM0+ r0p1, little endian, MPU, no FPU, VTOR, 2 interrupt priority bits
Registers are 8-bit, read-write, reset 0x0 unless marked. A register's access mark holds for its fields unless they carry their own. Offsets are from the block's base; [hi:lo] are bit positions.

## PORT — Port functions
Base 0x40040000
0x30 PU0 (reset mask 0x7F) — Pull-up resistor option register 0
0x31 PU1 — Pull-up resistor option register 1
0x33 PU3 (reset mask 0x3) — Pull-up resistor option register 3
0x34 PU4 reset 0x1 (reset mask 0x3F) — Pull-up resistor option register 4
0x35 PU5 — Pull-up resistor option register 5
0x36 PU6 (reset mask 0xF0) — Pull-up resistor option register 6
0x37 PU7 — Pull-up resistor option register 7
0x3A PU10 (reset mask 0x1) — Pull-up resistor option register 10
0x3B PU11 (reset mask 0x3) — Pull-up resistor option register 11
0x3C PU12 (reset mask 0x1) — Pull-up resistor option register 12
0x3D PU13 reset 0x80 (reset mask 0xC0) — Pull-up resistor option register 13
0x3E PU14 (reset mask 0xDF) — Pull-up resistor option register 14
0x40 PIM0 (reset mask 0x1A) — Port input mode register 0
0x41 PIM1 (reset mask 0xF1) — Port input mode register 1
0x43 PIM3 (reset mask 0x1) — Port input mode register 3
0x44 PIM4 (reset mask 0x14) — Port input mode register 4
0x45 PIM5 (reset mask 0x21) — Port input mode register 5
0x47 PIM7 (reset mask 0x16) — Port input mode register 7
0x4E PIM14 (reset mask 0xC) — Port input mode register 14
0x50 POM0 (reset mask 0x1D) — Port output mode register 0
0x51 POM1 (reset mask 0xBB) — Port output mode register 1
0x53 POM3 (reset mask 0x1) — Port output mode register 3
0x54 POM4 (reset mask 0x14) — Port output mode register 4
0x55 POM5 (reset mask 0x23) — Port output mode register 5
0x57 POM7 (reset mask 0x12) — Port output mode register 7
0x5E POM14 (reset mask 0x1C) — Port output mode register 14
0x60 PMC0 reset 0xFF (reset mask 0x1C) — Port mode control register 0
0x61 PMC1 reset 0xFF (reset mask 0x3) — Port mode control register 1
0x62 PMC2 reset 0xFF — Port mode control register 2
0x6A PMC10 reset 0xFF (reset mask 0x1) — Port mode control register 10
0x6C PMC12 reset 0xFF (reset mask 0x1) — Port mode control register 12
0x6D PMC13 reset 0xFF (reset mask 0x40) — Port mode control register 13
0x6E PMC14 reset 0xFF (reset mask 0xC0) — Port mode control register 14
0x6F PMC15 reset 0xFF (reset mask 0xF) — Port mode control register 15
0x80 PSET0 (reset mask 0x7F) — Port set register 0
0x81 PSET1 — Port set register 1
0x82 PSET2 — Port set register 2
0x83 PSET3 (reset mask 0x3) — Port set register 3
0x84 PSET4 (reset mask 0x3F) — Port set register 4
0x85 PSET5 (reset mask 0x3F) — Port set register 5
0x86 PSET6 — Port set register 6
0x87 PSET7 — Port set register 7
0x8A PSET10 (reset mask 0x1) — Port set register 10
0x8B PSET11 (reset mask 0x3) — Port set register 11
0x8C PSET12 (reset mask 0x1F) — Port set register 12
0x8D PSET13 (reset mask 0xC1) — Port set register 13
0x8E PSET14 (reset mask 0xDF) — Port set register 14
0x8F PSET15 (reset mask 0xF) — Port set register 15
0x90 PCLR0 (reset mask 0x7F) — Port clear register 0
0x91 PCLR1 — Port clear register 1
0x92 PCLR2 — Port clear register 2
0x93 PCLR3 (reset mask 0x3) — Port clear register 3
0x94 PCLR4 (reset mask 0x3F) — Port clear register 4
0x95 PCLR5 (reset mask 0x3F) — Port clear register 5
0x96 PCLR6 — Port clear register 6
0x97 PCLR7 — Port clear register 7
0x9A PCLR10 (reset mask 0x1) — Port clear register 10
0x9B PCLR11 (reset mask 0x3) — Port clear register 11
0x9C PCLR12 (reset mask 0x1) — Port clear register 12
0x9D PCLR13 (reset mask 0xC1) — Port clear register 13
0x9E PCLR14 (reset mask 0xDF) — Port clear register 14
0x9F PCLR15 (reset mask 0xF) — Port clear register 15
0xA0 PREAD0 reset 0xA0 (reset mask 0x7F) — Port read register 0
0xA1 PREAD1 — Port read register 1
0xA2 PREAD2 — Port read register 2
0xA3 PREAD3 (reset mask 0x3) — Port read register 3
0xA4 PREAD4 (reset mask 0x3F) — Port read register 4
0xA5 PREAD5 (reset mask 0x3F) — Port read register 5
0xA6 PREAD6 — Port read register 6
0xA7 PREAD7 — Port read register 7
0xAA PREAD10 (reset mask 0x1) — Port read register 10
0xAB PREAD11 (reset mask 0x3) — Port read register 11
0xAC PREAD12 (reset mask 0x1F) — Port read register 12
0xAD PREAD13 (reset mask 0xC1) — Port read register 13
0xAE PREAD14 (reset mask 0xDF) — Port read register 14
0xAF PREAD15 (reset mask 0xF) — Port read register 15
0x300 P0 (reset mask 0x7F) — Port register 0
0x301 P1 — Port register 1
0x302 P2 — Port register 2
0x303 P3 (reset mask 0x3) — Port register 3
0x304 P4 (reset mask 0x3F) — Port register 4
0x305 P5 (reset mask 0x3F) — Port register 5
0x306 P6 — Port register 6
0x307 P7 — Port register 7
0x30A P10 (reset mask 0x1) — Port register 10
0x30B P11 (reset mask 0x3) — Port register 11
0x30C P12 (reset mask 0x1F) — Port register 12
0x30D P13 (reset mask 0xC1) — Port register 13
0x30E P14 (reset mask 0xDF) — Port register 14
0x30F P15 (reset mask 0xF) — Port register 15
0x320 PM0 reset 0xFF (reset mask 0x7F) — Port mode register 0
0x321 PM1 reset 0xFF — Port mode register 1
0x322 PM2 reset 0xFF — Port mode register 2
0x323 PM3 reset 0xFF (reset mask 0x3) — Port mode register 3
0x324 PM4 reset 0xFF (reset mask 0x3F) — Port mode register 4
0x325 PM5 reset 0xFF (reset mask 0x3F) — Port mode register 5
0x326 PM6 reset 0xFF — Port mode register 6
0x327 PM7 reset 0xFF — Port mode register 7
0x32A PM10 reset 0xFF (reset mask 0x1) — Port mode register 10
0x32B PM11 reset 0xFF (reset mask 0x3) — Port mode register 11
0x32C PM12 reset 0xFF (reset mask 0x1) — Port mode register 12
0x32D PM13 reset 0xFE (reset mask 0xC0) — Port mode register 13
0x32E PM14 reset 0xFF (reset mask 0xDF) — Port mode register 14
0x32F PM15 reset 0xFF (reset mask 0xF) — Port mode register 15
0x875 PIOR2 — Peripheral I/O redirection register 2
0x877 PIOR0 — Peripheral I/O redirection register 0
0x879 PIOR1 (reset mask 0xF) — Peripheral I/O redirection register 1
0x87B PMS (reset mask 0x1) — Port mode select register
0x87C PIOR3 (reset mask 0x3F) — Peripheral I/O redirection register 3
0x87D GDIDIS (reset mask 0x1) — Global digital input disable register
